## arch/arm/mach-tangox/Kconfig
```kconfig
if TANGO4

choice
	prompt "Tango4 board select"
	optional

config TARGET_SD87XX
	bool "Tango4 generic boards"

endchoice

config SYS_SOC
	default "tango4"

source "board/sigmadesigns/sd87xx/Kconfig"

endif
```

## arch/arm/mach-trix/Kconfig
```kconfig
config ARCH_SIGMA_TRIX
	bool

if ARCH_SIGMA_TRIX

menu "Sigma DTV SOC"
choice
	prompt "Soc series"

config SIGMA_SOC_UXLB
	depends on ARCH_SIGMA_TRIX_ARM
	bool "UXLB chipset"

config SIGMA_SOC_SX6
	depends on ARCH_SIGMA_TRIX_ARM
	bool "SX6 chipset"
	select SIGMA_TURING_IN_PLF_DCS

config SIGMA_SOC_SX7
	depends on ARCH_SIGMA_TRIX_ARM
	bool "SX7 chipset"

config SIGMA_SOC_SX8
	depends on ARCH_SIGMA_TRIX_ARM
	bool "SX8 chipset"

config SIGMA_SOC_UNION
	depends on ARCH_SIGMA_TRIX_ARM64
	bool "Union chipset"

endchoice

config SIGMA_TRIX_NAME
	string
	prompt "Enter SOC nanme"

choice
	prompt "Boot device"

config TRIX_MMC
	bool "eMMC boot"

config TRIX_NAND
	bool "Nand boot"

config TRIX_NONE
	bool "None"

endchoice

choice
	prompt "General Interrupt Controller"

config SIGMA_TRIX_GICV
	bool "GICv1 (i.e. Cortex-A9)"
	depends on ARCH_SIGMA_TRIX_ARM

config SIGMA_TRIX_GICV2
	bool "GICv2 (i.e. GIC-400)"

config SIGMA_TRIX_GICV3
	bool "GICv3 (i.e. GIC-500)"

endchoice

choice
	prompt "Sigma Designs TEE"
	depends on SECURE_MONITOR

config SIGMA_TEE_ARMOR
	bool "armor"
	depends on ARCH_SIGMA_TRIX_ARM
	help
	  armor for cortex-a9 project

config SIGMA_TEE_OPTEE
	bool "OPTEE"
	depends on ARCH_SIGMA_TRIX_ARM64
	help
	  OP-TEE for ARMv8-A projects

endchoice

config SIGMA_NR_UMACS
	int "Set counts of UMAC controller"
	default 2 if SIGMA_SOC_SX6 || SIGMA_SOC_UXLB
	default 3 if SIGMA_SOC_SX7 || SIGMA_SOC_SX8
	default 1

config SIGMA_PST_VER_1_X
	bool "PMAN Secure Table V1.X"
	depends on ARCH_SIGMA_TRIX_ARM64
	default y
	help
	  PMAN Secure Table version 1.x, in accordance with ATF.
	  if unsure say n.

config SIGMA_TURING_IN_PLF_DCS
	bool
	help
	  TURING target belongs to PLF DCS, i.e. SX6.
	  While not for SX7/SX8/UNION1.
	  if unsure say n.

menu "Sigma DTV features"

config BOARD_CONFIGURATION
	bool "Load Board configuration from disk"

config SYS_BOOTMIPS
	bool "Boot Display & AV mips in u-boot"

config SECURE_MONITOR
	bool "Support board with secure extension enable case"

config TEST_S2RAM
	bool "Support test S2RAM"

config SYSLOG
	bool "SYSLOG control"
	help
	SYSLOG

config SIGMA_MCONFIG
	bool "Enable MCONFIG"
	help
	Auto detect each UAMC size and save as ENV 'msize'

config SIGMA_AUTOUPDATE
	bool "Auto update from USB"
	depends on USB

config TRIX_TIMESTAMP
	bool "Use timer0 get high percision time stamp"
	help
	Use command 'showts' can show out soc timer value elapsed 
	clock @200MHz in ascending order 

config SIGMA_DTV_SECURITY
	bool "Enable image authentication for sdegisn dtv"
	help
	Enable this feature for image authentication.

config PANEL_ID_EXTENSION
	bool "Extend panel type to 16-bit long"

endmenu
endmenu
config SYS_SOC
	string
	default "trix" if ARCH_SIGMA_TRIX
	default "trix64" if ARCH_SIGMA_TRIX_ARM64

source "board/sigmadesigns/trix/Kconfig"

endif
```

## board/sigmadesigns/sd87xx/Kconfig
```kconfig
if TARGET_SD87XX

config SYS_BOARD
	default "sd87xx"

config SYS_VENDOR
	default "sigmadesigns"

config SYS_CONFIG_NAME
	default "sd87xx"

endif
```

## board/sigmadesigns/trix/Kconfig
```kconfig
config SYS_BOARD
	default "trix"

config SYS_VENDOR
	default "sigmadesigns"

config SYS_CONFIG_NAME
	default "sigma-dtv-common"
```

## configs/sx6_emmc_defconfig
```kconfig
CONFIG_ARM=y
CONFIG_CPU_V7=y
CONFIG_SYS_ARCH="arm"
CONFIG_SYS_CPU="armv7"
CONFIG_SYS_SOC="trix"
CONFIG_ARCH_SIGMA_TRIX=y
CONFIG_TARGET_SX6_EMMC=y

CONFIG_LOCALVERSION_AUTO=y
CONFIG_CC_OPTIMIZE_FOR_SIZE=y
CONFIG_EXPERT=y
CONFIG_SYS_MALLOC_CLEAR_ON_INIT=y

CONFIG_CMDLINE=y
CONFIG_HUSH_PARSER=y
CONFIG_SYS_HUSH_PARSER=y

CONFIG_SYS_HZ=1000
CONFIG_REGEX=y

CONFIG_CMD_IMLS=n
CONFIG_CMD_SETEXPR=n
```

## configs/sx7_emmc_defconfig
```kconfig
CONFIG_ARM=y
CONFIG_ARCH_SIGMA_TRIX=y
CONFIG_MACH_SIGMA_SX7=y
CONFIG_SIGMA_TRIX_NAME="SX7"
CONFIG_BOARD_CONFIGURATION=y
CONFIG_SYS_BOOTMIPS=y
CONFIG_SECURE_MONITOR=y
CONFIG_TEST_S2RAM=y
CONFIG_SYSLOG=y
CONFIG_SIGMA_MCONFIG=y
CONFIG_SIGMA_AUTOUPDATE=y
CONFIG_TRIX_TIMESTAMP=y
CONFIG_DEFAULT_DEVICE_TREE="trix-sx"
CONFIG_FIT=y
CONFIG_HUSH_PARSER=y
CONFIG_SYS_PROMPT="SX7-EMMC# "
# CONFIG_CMD_IMLS is not set
# CONFIG_CMD_SETEXPR is not set
CONFIG_OF_CONTROL=y
CONFIG_DM=y
CONFIG_NETDEVICES=y
CONFIG_ETH_DESIGNWARE=y
CONFIG_USB=y
CONFIG_DM_USB=y
CONFIG_USB_XHCI_HCD=y
CONFIG_USB_XHCI_TRIX=y
CONFIG_USB_EHCI_HCD=y
CONFIG_USB_EHCI_TRIX=y
```

## configs/union_emmc_defconfig
```kconfig
CONFIG_ARM=y
CONFIG_ARCH_SIGMA_TRIX_ARM64=y
CONFIG_SIGMA_TRIX_NAME="UNION"
CONFIG_TRIX_NONE=y
CONFIG_SIGMA_TRIX_GICV3=y
CONFIG_TEST_S2RAM=y
CONFIG_SYSLOG=y
CONFIG_SIGMA_MCONFIG=y
CONFIG_TRIX_TIMESTAMP=y
CONFIG_DEFAULT_DEVICE_TREE="trix-sx"
# CONFIG_SYS_MALLOC_CLEAR_ON_INIT is not set
CONFIG_FIT=y
CONFIG_HUSH_PARSER=y
CONFIG_SYS_PROMPT="UNION-EMMC# "
# CONFIG_CMD_IMLS is not set
# CONFIG_CMD_SETEXPR is not set
# CONFIG_CMD_NET is not set
# CONFIG_CMD_NFS is not set
CONFIG_OF_CONTROL=y
CONFIG_DM=y
CONFIG_REGEX=y
```

## configs/uxlb_evb_defconfig
```kconfig
CONFIG_ARM=y
CONFIG_ARCH_SIGMA_TRIX_ARM=y
CONFIG_SIGMA_TRIX_NAME="UXLB"
CONFIG_TRIX_NAND=y
CONFIG_BOARD_CONFIGURATION=y
CONFIG_SYS_BOOTMIPS=y
CONFIG_SECURE_MONITOR=y
CONFIG_TEST_S2RAM=y
CONFIG_SYSLOG=y
CONFIG_SIGMA_MCONFIG=y
CONFIG_SIGMA_AUTOUPDATE=y
CONFIG_TRIX_TIMESTAMP=y
CONFIG_DEFAULT_DEVICE_TREE="trix-uxlb"
CONFIG_FIT=y
CONFIG_HUSH_PARSER=y
CONFIG_SYS_PROMPT="UXLB-EVB# "
# CONFIG_CMD_IMLS is not set
# CONFIG_CMD_SETEXPR is not set
CONFIG_OF_CONTROL=y
CONFIG_DM=y
CONFIG_NETDEVICES=y
CONFIG_FTMAC110=y
CONFIG_USB=y
CONFIG_DM_USB=y
CONFIG_USB_EHCI_HCD=y
CONFIG_USB_EHCI_TRIX=y
```
