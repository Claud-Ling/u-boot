/dts-v1/;

/ {
	#address-cells = <1>;
	#size-cells = <1>;

	usb@fb003000 {
		compatible = "sigmadtv,trix-ehci";
		reg = <0xf502f000 0x1000>;
		interrupts = <47>;
	};

	usb@fb007000 {
		compatible = "sigmadtv,trix-ehci";
		reg = <0xfb008000 0x1000>;
		interrupts = <47>;
	};

};
